## ESP32MASTER/sdkconfig.defaults
```kconfig
# Watchdog Timer Configuration - Disable task watchdog to prevent resets
CONFIG_ESP_TASK_WDT_EN=n
CONFIG_ESP_TASK_WDT_INIT=n
CONFIG_TASK_WDT=n

# FreeRTOS Configuration
CONFIG_FREERTOS_HZ=1000
CONFIG_FREERTOS_IDLE_TASK_STACKSIZE=2048 
```
